/*
 * Device Tree file for Freescale LS1088a software Simulator model
 *
 * Copyright (C) 2015, Freescale Semiconductor
 *
 */

/dts-v1/;

/include/ "fsl-ls1088a.dtsi"

/ {
	model = "Freescale Layerscape 2085a software Simulator model";
	compatible = "fsl,ls1088a-simu", "fsl,ls1088a";
};
